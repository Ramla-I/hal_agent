# S32K146 register map
Vendor: NXP; Series: S32K; File version: 1.6
S32K146 NXP Microcontroller
CPU: CM4 r0p1, little endian, MPU, FPU, 4 interrupt priority bits
Registers are 32-bit, read-write, reset 0x0 unless marked. A register's access mark holds for its fields unless they carry their own. Offsets are from the block's base; lines under a group give offsets from that group; [hi:lo] are bit positions; {n}, {i} and the like mark numbered series; 'fields as' and 'values as' point back to an identical list; <NAME> marks a mode.

## Memory map
0x14001000 CSE_PRAM size 0x80
0x40000000 AIPS size 0x70 — AIPS-Lite Bridge
0x40001000 MSCM size 0x40C
0x40008000 DMA size 0x1200 — Enhanced Direct Memory Access
0x4000D000 MPU size 0x820 — Memory protection unit
0x40018000 ERM size 0x114
0x40019000 EIM size 0x208 — Error Injection Module
0x40020000 FTFC size 0x30
0x40021000 DMAMUX size 0x10 — DMA channel multiplexor
0x40024000 CAN0 size 0xC0C — Flex Controller Area Network module
0x40025000 CAN1 size 0xC0C — Flex Controller Area Network module
0x40026000 FTM3 size 0x224 — FlexTimer Module
0x40027000 ADC1 size 0x1E8 — Analog-to-Digital Converter
0x4002B000 CAN2 size 0xC0C — Flex Controller Area Network module
0x4002C000 LPSPI0 size 0x78 — The LPSPI Memory Map/Register Definition can be found here.
0x4002D000 LPSPI1 size 0x78 — The LPSPI Memory Map/Register Definition can be found here.
0x4002E000 LPSPI2 size 0x78 — The LPSPI Memory Map/Register Definition can be found here.
0x40031000 PDB1 size 0x198 — Programmable Delay Block
0x40032000 CRC size 0xC — Cyclic Redundancy Check
0x40036000 PDB0 size 0x198 — Programmable Delay Block
0x40037000 LPIT0 size 0x5C — Low Power Periodic Interrupt Timer (LPIT)
0x40038000 FTM0 size 0x224 — FlexTimer Module
0x40039000 FTM1 size 0x224 — FlexTimer Module
0x4003A000 FTM2 size 0x224 — FlexTimer Module
0x4003B000 ADC0 size 0x1E8 — Analog-to-Digital Converter
0x4003D000 RTC size 0x20 — Secure Real Time Clock
0x40040000 LPTMR0 size 0x10 — Low Power Timer
0x40048000 SIM blocks up to offset 0x70 — System Integration Module
0x40049000 PORTA size 0xCC — Pin Control and Interrupts
0x4004A000 PORTB size 0xCC — Pin Control and Interrupts
0x4004B000 PORTC size 0xCC — Pin Control and Interrupts
0x4004C000 PORTD size 0xCC — Pin Control and Interrupts
0x4004D000 PORTE size 0xCC — Pin Control and Interrupts
0x40052000 WDOG size 0x10 — Watchdog timer
0x4005A000 FLEXIO size 0x510 — The FLEXIO Memory Map/Register Definition can be found here.
0x40061000 EWM size 0x6 — External Watchdog Monitor
0x40063000 TRGMUX size 0x78
0x40064000 SCG size 0x60C — System Clock Generator
0x40065000 PCC size 0x1D0
0x40066000 LPI2C0 size 0x174 — The LPI2C Memory Map/Register Definition can be found here.
0x4006A000 LPUART0 size 0x30 — Universal Asynchronous Receiver/Transmitter
0x4006B000 LPUART1 size 0x30 — Universal Asynchronous Receiver/Transmitter
0x4006C000 LPUART2 size 0x30 — Universal Asynchronous Receiver/Transmitter
0x4006E000 FTM4 size 0x224 — FlexTimer Module
0x4006F000 FTM5 size 0x224 — FlexTimer Module
0x40073000 CMP0 size 0xC — High-Speed Comparator (CMP), Voltage Reference (VREF) Digital-to-Analog Converter (DAC), and Analog Mux (ANMUX)
0x4007D000 PMC size 0x5
0x4007E000 SMC size 0x18 — System Mode Controller
0x4007F000 RCM size 0x20 — Reset Control Module
0x400FF000 PTA size 0x1C — General Purpose Input/Output
0x400FF040 PTB size 0x1C — General Purpose Input/Output
0x400FF080 PTC size 0x1C — General Purpose Input/Output
0x400FF0C0 PTD size 0x1C — General Purpose Input/Output
0x400FF100 PTE size 0x1C — General Purpose Input/Output
0xE000E000 S32_SCB blocks up to offset 0xF40 — System Control Registers
0xE000E010 S32_SysTick size 0x10 — System timer
0xE000E100 S32_NVIC size 0xE04 — Nested Vectored Interrupt Controller
0xE0080000 MCM blocks up to offset 0x4A8 — Core Platform Miscellaneous Control Module
0xE0082000 LMEM size 0x24 — Local Memory Controller

## Interrupts
{n} DMA{n} (DMA, S32_NVIC) (n=0..15)
16 DMA_Error (DMA, S32_NVIC)
17 MCM (S32_NVIC, MCM)
18 FTFC (FTFC, S32_NVIC)
19 Read_Collision (FTFC, S32_NVIC)
20 LVD_LVW (PMC, S32_NVIC)
21 FTFC_Fault (FTFC, S32_NVIC)
22 WDOG_EWM (WDOG, EWM, S32_NVIC)
23 RCM (RCM, S32_NVIC)
24 LPI2C0_Master (LPI2C0, S32_NVIC)
25 LPI2C0_Slave (LPI2C0, S32_NVIC)
26 LPSPI0 (LPSPI0, S32_NVIC)
27 LPSPI1 (LPSPI1, S32_NVIC)
28 LPSPI2 (LPSPI2, S32_NVIC)
31 LPUART0_RxTx (LPUART0, S32_NVIC)
33 LPUART1_RxTx (LPUART1, S32_NVIC)
35 LPUART2_RxTx (LPUART2, S32_NVIC)
39 ADC0 (ADC0, S32_NVIC)
40 ADC1 (ADC1, S32_NVIC)
41 CMP0 (CMP0, S32_NVIC)
44 ERM_single_fault (ERM, S32_NVIC)
45 ERM_double_fault (ERM, S32_NVIC)
46 RTC (RTC, S32_NVIC)
47 RTC_Seconds (RTC, S32_NVIC)
48 LPIT0_Ch0 (LPIT0, S32_NVIC)
49 LPIT0_Ch1 (LPIT0, S32_NVIC)
50 LPIT0_Ch2 (LPIT0, S32_NVIC)
51 LPIT0_Ch3 (LPIT0, S32_NVIC)
52 PDB0 (PDB0, S32_NVIC)
57 SCG (SCG, S32_NVIC)
58 LPTMR0 (LPTMR0, S32_NVIC)
59 PORTA (PORTA, S32_NVIC)
60 PORTB (PORTB, S32_NVIC)
61 PORTC (PORTC, S32_NVIC)
62 PORTD (PORTD, S32_NVIC)
63 PORTE (PORTE, S32_NVIC)
64 SWI (S32_NVIC)
68 PDB1 (PDB1, S32_NVIC)
69 FLEXIO (FLEXIO, S32_NVIC)
78 CAN0_ORed (CAN0, S32_NVIC)
79 CAN0_Error (CAN0, S32_NVIC)
80 CAN0_Wake_Up (CAN0, S32_NVIC)
81 CAN0_ORed_0_15_MB (CAN0, S32_NVIC)
82 CAN0_ORed_16_31_MB (CAN0, S32_NVIC)
85 CAN1_ORed (CAN1, S32_NVIC)
86 CAN1_Error (CAN1, S32_NVIC)
88 CAN1_ORed_0_15_MB (CAN1, S32_NVIC)
89 CAN1_ORed_16_31_MB (CAN1, S32_NVIC)
92 CAN2_ORed (CAN2, S32_NVIC)
93 CAN2_Error (CAN2, S32_NVIC)
95 CAN2_ORed_0_15_MB (CAN2, S32_NVIC)
99 FTM0_Ch0_Ch1 (FTM0, S32_NVIC)
100 FTM0_Ch2_Ch3 (FTM0, S32_NVIC)
101 FTM0_Ch4_Ch5 (FTM0, S32_NVIC)
102 FTM0_Ch6_Ch7 (FTM0, S32_NVIC)
103 FTM0_Fault (FTM0, S32_NVIC)
104 FTM0_Ovf_Reload (FTM0, S32_NVIC)
105 FTM1_Ch0_Ch1 (FTM1, S32_NVIC)
106 FTM1_Ch2_Ch3 (FTM1, S32_NVIC)
107 FTM1_Ch4_Ch5 (FTM1, S32_NVIC)
108 FTM1_Ch6_Ch7 (FTM1, S32_NVIC)
109 FTM1_Fault (FTM1, S32_NVIC)
110 FTM1_Ovf_Reload (FTM1, S32_NVIC)
111 FTM2_Ch0_Ch1 (FTM2, S32_NVIC)
112 FTM2_Ch2_Ch3 (FTM2, S32_NVIC)
113 FTM2_Ch4_Ch5 (FTM2, S32_NVIC)
114 FTM2_Ch6_Ch7 (FTM2, S32_NVIC)
115 FTM2_Fault (FTM2, S32_NVIC)
116 FTM2_Ovf_Reload (FTM2, S32_NVIC)
117 FTM3_Ch0_Ch1 (FTM3, S32_NVIC)
118 FTM3_Ch2_Ch3 (FTM3, S32_NVIC)
119 FTM3_Ch4_Ch5 (FTM3, S32_NVIC)
120 FTM3_Ch6_Ch7 (FTM3, S32_NVIC)
121 FTM3_Fault (FTM3, S32_NVIC)
122 FTM3_Ovf_Reload (FTM3, S32_NVIC)
123 FTM4_Ch0_Ch1 (FTM4, S32_NVIC)
124 FTM4_Ch2_Ch3 (FTM4, S32_NVIC)
125 FTM4_Ch4_Ch5 (FTM4, S32_NVIC)
126 FTM4_Ch6_Ch7 (FTM4, S32_NVIC)
127 FTM4_Fault (FTM4, S32_NVIC)
128 FTM4_Ovf_Reload (FTM4, S32_NVIC)
129 FTM5_Ch0_Ch1 (FTM5, S32_NVIC)
130 FTM5_Ch2_Ch3 (FTM5, S32_NVIC)
131 FTM5_Ch4_Ch5 (FTM5, S32_NVIC)
132 FTM5_Ch6_Ch7 (FTM5, S32_NVIC)
133 FTM5_Fault (FTM5, S32_NVIC)
134 FTM5_Ovf_Reload (FTM5, S32_NVIC)

## Licence text in the file
Redistribution and use in source and binary forms, with or without modification, are permitted provided that the following conditions are met: o Redistributions of source code must retain the above copyright notice, this list of conditions and the following disclaimer. o Redistributions in binary form must reproduce the above copyright notice, this list of conditions and the following disclaimer in the documentation and/or other materials provided with the distribution. o Neither the name of Freescale Semiconductor, Inc. nor the names of its contributors may be used to endorse or promote products derived from this software without specific prior written permission. THIS SOFTWARE IS PROVIDED BY THE COPYRIGHT HOLDERS AND CONTRIBUTORS "AS IS" AND. ANY EXPRESS OR IMPLIED WARRANTIES, INCLUDING, BUT NOT LIMITED TO, THE IMPLIED. WARRANTIES OF MERCHANTABILITY AND FITNESS FOR A PARTICULAR PURPOSE ARE. DISCLAIMED. IN NO EVENT SHALL THE COPYRIGHT HOLDER OR CONTRIBUTORS BE LIABLE FOR. ANY DIRECT, INDIRECT, INCIDENTAL, SPECIAL, EXEMPLARY, OR CONSEQUENTIAL DAMAGES (INCLUDING, BUT NOT LIMITED TO, PROCUREMENT OF SUBSTITUTE GOODS OR SERVICES; LOSS OF USE, DATA, OR PROFITS; OR BUSINESS INTERRUPTION) HOWEVER CAUSED AND ON. ANY THEORY OF LIABILITY, WHETHER IN CONTRACT, STRICT LIABILITY, OR TORT (INCLUDING NEGLIGENCE OR OTHERWISE) ARISING IN ANY WAY OUT OF THE USE OF THIS. SOFTWARE, EVEN IF ADVISED OF THE POSSIBILITY OF SUCH DAMAGE.
